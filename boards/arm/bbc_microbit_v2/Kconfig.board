## boards/arm/bbc_microbit_v2/Kconfig.board
```kconfig
# nRF51 BBC_MICROBIT board configuration

# Copyright (c) 2016 Nordic Semiconductor ASA.
# SPDX-License-Identifier: Apache-2.0

config BOARD_BBC_MICROBIT_V2
	bool "BBC MICRO:BIT V2"
	depends on SOC_NRF52833_QIAA
```

## boards/arm/bbc_microbit_v2/Kconfig.defconfig
```kconfig
# nRF51 BBC_MICROBIT board configuration

# Copyright (c) 2016 Nordic Semiconductor ASA
# SPDX-License-Identifier: Apache-2.0

if BOARD_BBC_MICROBIT_V2

config BOARD
	default "bbc_microbit_v2"

config BT_CTLR
	default BT

endif # BOARD_BBC_MICROBIT_V2
```

## boards/arm/fanstel_ev832x/Kconfig.defconfig
```kconfig
# Kconfig - Fanstel EV-BT832X board configuration
#
# Copyright (c) 2019 SixOctets Systems
#
# SPDX-License-Identifier: Apache-2.0


if BOARD_FANSTEL_EV832X

config BOARD
	default "Fanstel EV-BT832X"

if I2C

config I2C_0
	default y

endif # I2C

endif # BOARD_FANSTEL_EV832X
```

## ext/lib/ipc/rpmsg-lite/Kconfig
```kconfig
#
# Copyright (c) 2019 Linaro Limited
#
# SPDX-License-Identifier: Apache-2.0
#

config RPMSG_LITE
	bool "RPMsg-lite Support"
	help
	  This option enables the RPMsg-lite.

config RPMSGLITE_SRC_PATH
	string "RPMsg-lite library source path"
	default "rpmsg-lite"
	depends on RPMSG_LITE
	help
	  This option specifies the path to the source for the rpmsg-lite library
```

## subsys/app_memory/Kconfig
```kconfig
menu "General Kernel Options"
config APP_SHARED_MEM
    bool
    prompt "alt application shared memory"
    default n
    help
      This is a testing option
endmenu
```
